## esp-idf-component/templates/Kconfig
```kconfig
menu "{{COMPONENT_TITLE}} Configuration"

    config {{COMPONENT_NAME_UPPER}}_EXAMPLE_OPTION
        bool "Example boolean option"
        default y
        help
            Replace this with real component options, or delete this Kconfig
            file entirely if the component has nothing to configure.

endmenu
```

## esp-idf-component/templates/example-basic/sdkconfig.defaults
```kconfig
# Reduce bootloader log verbosity
CONFIG_BOOTLOADER_LOG_LEVEL_WARN=y
CONFIG_BOOTLOADER_LOG_LEVEL=2

CONFIG_LOG_COLORS=y
```
